#include "modules/display.h"
static const uint8_t animation_wrench_32_32_14f_frames[14][128] = {
  {0x00,0x00,0x00,0x00,0x00,0x00,0xa0,0x00,0x00,0x00,0xf8,0x03,0x00,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0x00,0x00},
  {0x00,0x00,0x00,0x00,0x00,0x00,0xa0,0x00,0x00,0x00,0xf8,0x03,0x00,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0x00,0x00},
  {0x00,0x00,0x00,0x00,0x00,0x00,0xe0,0x01,0x00,0x00,0xf8,0x03,0x00,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0x00,0x00},
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  {0x00,0x00,0x00,0x00,0x00,0x00,0xa0,0x00,0x00,0x00,0xf8,0x03,0x00,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0x00,0x00}
};
static const uint8_t animation_play_load_32_32_14f_frames[14][128] = {
  {0x00,0x00,0x00,0x00,0x00,0xc0,0x01,0x00,0x00,0xfc,0x3f,0x00,0x00,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0x00,0x00},
  {0x00,0x00,0x00,0x00,0x00,0xc0,0x01,0x00,0x00,0xfc,0x3f,0x00,0x00,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0x00,0x00},
  {0x00,0x00,0x00,0x00,0x00,0xc0,0x01,0x00,0x00,0xfc,0x3f,0x00,0x00,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0x00,0x00},
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  {0x00,0x00,0x00,0x00,0x00,0xc0,0x01,0x00,0x00,0xfc,0x3f,0x00,0x00,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0x00,0x00}
};
static const uint8_t animation_warning_blink_32_32_14f_frames[14][128] = {
  {0x00,0x00,0x00,0x00,0x00,0xc0,0x01,0x00,0x00,0xfc,0x3f,0x00,0x00,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0x00,0x00},
  {0x00,0x00,0x00,0x00,0x00,0x80,0x03,0x00,0x00,0x78,0x1f,0x00,0x00,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0x00,0x00},
  {0x00,0x00,0x00,0x00,0x00,0xc0,0x07,0x00,0x00,0x7c,0x3e,0x00,0x00,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0x00,0x00},
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  {0x00,0x00,0x00,0x00,0x00,0x00,0x01,0x00,0x00,0xf8,0x1f,0x00,0x00,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0x00,0x00}
};

u8g2_t u8g2;

static uiPantalla_t pantalla     = UI_INICIO;
static bool_t       sucia        = TRUE;
static bool_t       frameEnCurso = FALSE;

static uint16_t     angle        = 0;
static uint8_t animFrame = 0;

// Datos que tenemos que sacar del disco
static char titulo [UI_TEXTO_MAX] = "stupid song";
static char artista[UI_TEXTO_MAX] = "Olivia Rodrigo";

/* ------------------------------- DISCO (cambiar por animación) ------------------------------- */

static void drawArc(int cx, int cy, int r, int startDeg, int spanDeg)
{
  const int step = 8;
  int px = cx + (int)roundf(r * cosf(startDeg * DEG2RAD));
  int py = cy + (int)roundf(r * sinf(startDeg * DEG2RAD));
  
  for (int d = step; d <= spanDeg; d += step) {
    float rad = (startDeg + d) * DEG2RAD;
    int x = cx + (int)roundf(r * cosf(rad));
    int y = cy + (int)roundf(r * sinf(rad));
    u8g2_DrawLine(&u8g2, px, py, x, y);
    px = x;
    py = y;
  }
}

static void drawSpinningDisc(uint16_t ang)
{
    u8g2_DrawCircle(&u8g2, DISC_CX, DISC_CY, 24, U8G2_DRAW_ALL);
    u8g2_DrawCircle(&u8g2, DISC_CX, DISC_CY, 10, U8G2_DRAW_ALL);

    // Reflejos
    drawArc(DISC_CX, DISC_CY, 20, ang,       50);
    drawArc(DISC_CX, DISC_CY, 15, ang + 180, 30);

    // Agujero central
    u8g2_SetDrawColor(&u8g2, 0);
    u8g2_DrawDisc(&u8g2, DISC_CX, DISC_CY, 3, U8G2_DRAW_ALL);
    u8g2_SetDrawColor(&u8g2, 1);
    u8g2_DrawPixel(&u8g2, DISC_CX, DISC_CY);
}

static uint8_t centrar(const char *texto)
{
    uint16_t ancho = u8g2_GetStrWidth(&u8g2, texto);
    return (ancho >= DISPLAY_WIDTH) ? 0 : (DISPLAY_WIDTH - ancho) / 2;
}

/* ------------------------------- PANTALLAS ------------------------------- */
static void drawInitScreen(void)
{
  u8g2_DrawXBMP(&u8g2, 48, 28, 32, 32, animation_play_load_32_32_14f_frames[animFrame]);
  
  u8g2_SetFont(&u8g2, u8g2_font_t0_22_tr);
  u8g2_DrawStr(&u8g2, 9, 22, "TOCADISCOS");
}

static void drawWaitingScreen(void)//MEJORAR
{
  u8g2_SetFont(&u8g2, u8g2_font_t0_14_tr);
  u8g2_DrawStr(&u8g2, 19, 22, "Sistema listo");
  u8g2_DrawStr(&u8g2, 15, 53, "Apoye un disco");
}

static void drawPlayingScreen(void)
{
    u8g2_SetFont(&u8g2, u8g2_font_t0_14_tr);
    u8g2_DrawTriangle(&u8g2, 2, 2, 2, 10, 8, 6);
    u8g2_DrawStr(&u8g2, 13, 10, "REPRODUCIENDO");

    u8g2_SetClipWindow(&u8g2, 0, 0, 75, 63);

    u8g2_SetFont(&u8g2, u8g2_font_5x8_tf);
    u8g2_DrawStr(&u8g2, 2, 30, titulo);
    u8g2_DrawStr(&u8g2, 2, 50, artista);

    u8g2_SetMaxClipWindow(&u8g2);

    // Disco
    drawSpinningDisc(angle);
}

static void drawTrackEndScreen(void)//CALCULAR POSICION
{
    u8g2_SetFont(&u8g2, u8g2_font_t0_14_tr);
    u8g2_DrawStr(&u8g2, 8, 22, "Pista finalizada");

    u8g2_SetFont(&u8g2, u8g2_font_5x8_tr);
    u8g2_DrawStr(&u8g2, centrar(titulo), 47, titulo);
    
    char cantante[32];
    snprintf(cantante, sizeof(cantante), "de %s", artista);
    u8g2_DrawStr(&u8g2, centrar(cantante), 55, cantante);
}

static void drawUnknownDiscScreen(void)
{
  u8g2_DrawXBMP(&u8g2, 48, 6, 32, 32, animation_warning_blink_32_32_14f_frames[animFrame]);

  u8g2_SetFont(&u8g2, u8g2_font_t0_14_tr);
  u8g2_DrawUTF8(&u8g2, 8, 60, "Disco desconocido");
}

static void drawConfigScreen(void)
{
    u8g2_SetFont(&u8g2, u8g2_font_5x8_tf);
    u8g2_DrawStr(&u8g2, 5, 12, "(futura pantalla de configuración)");
}

static void drawErrorScreen(void)
{
    u8g2_DrawXBMP(&u8g2, 48, 6, 32, 32, animation_wrench_32_32_14f_frames[animFrame]);

    u8g2_SetFont(&u8g2, u8g2_font_t0_14_tf);
    u8g2_DrawUTF8(&u8g2, 8, 60, "Ocurrió un error");
}

/* ------------------------------- FUNCIONES PRIVADAS ------------------------------- */
static void dibujarPantalla(void)
{
    switch (pantalla) {
    case UI_INICIO:        drawInitScreen();        break;
    case UI_ESPERA:        drawWaitingScreen();     break;
    case UI_REPRODUCIENDO: drawPlayingScreen();     break;
    case UI_FIN_PISTA:     drawTrackEndScreen();    break;
    case UI_NO_REGISTRADO: drawUnknownDiscScreen(); break;
    case UI_CONFIG:        drawConfigScreen();      break;
    case UI_ERROR:         drawErrorScreen();       break;
    }
}

static bool_t pantallaAnimada(void)
{
  return (pantalla == UI_REPRODUCIENDO) || (pantalla == UI_ERROR) || (pantalla == UI_INICIO) || (pantalla == UI_NO_REGISTRADO);
}

static void avanzarAnimacion(void)
{
    switch (pantalla) {
    case UI_REPRODUCIENDO: angle     = (angle + ANGLE_STEP) % 360;  break;
    case UI_INICIO:
    case UI_NO_REGISTRADO:
    case UI_ERROR:         animFrame = (animFrame + 1) % ANIMATION_FRAMES; break;
    default: break;
    }
}

/* ------------------------------- FUNCIONES PUBLICAS ------------------------------- */
void displayInit(void)
{
    oledInit(&u8g2);
    pantalla = UI_INICIO;
    sucia = TRUE;
    frameEnCurso = FALSE;
}

void uiMostrar(uiPantalla_t p)
{
    pantalla     = p;
    angle        = 0;           /* la animacion arranca desde el principio    */
    frameEnCurso = FALSE;       /* abandona el cuadro en curso, si lo habia   */
    sucia        = TRUE;
  }
  
void tareaPantalla(void) {
    if (!frameEnCurso) {
        if (pantallaAnimada()) {
            avanzarAnimacion();
        } else if (!sucia) {
            return;
        }
        sucia = FALSE;
        u8g2_FirstPage(&u8g2);
        frameEnCurso = TRUE;
    }

    dibujarPantalla();
    if (!u8g2_NextPage(&u8g2)) {
        frameEnCurso = FALSE;
    }
}
